## nethunter-configs/nethunter_defconfig
```kconfig
# Kali NetHunter Kernel Configuration Options
# These options enable NetHunter features in the kernel
# Add these to your kernel defconfig or enable via menuconfig

# General
CONFIG_SYSVIPC=y

# Modules
CONFIG_MODULES=y
CONFIG_MODULE_UNLOAD=y
CONFIG_MODULE_FORCE_UNLOAD=y
CONFIG_MODVERSIONS=y

# Android Binder
CONFIG_ANDROID_BINDER_IPC=y

# Bluetooth
CONFIG_BT_HCIBTUSB=y
CONFIG_BT_HCIBTUSB_BCM=y
CONFIG_BT_HCIBTUSB_RTL=y
CONFIG_BT_HCIUART=y
CONFIG_BT_HCIUART_H4=y
CONFIG_BT_HCIBCM203X=y
CONFIG_BT_HCIBPA10X=y
CONFIG_BT_HCIBFUSB=y
CONFIG_BT_HCIVHCI=y

# MAC80211 (Wireless Stack)
#CONFIG_CFG80211=m
CONFIG_CFG80211_WEXT=y
CONFIG_MAC80211=y
CONFIG_MAC80211_MESH=y

# Ethernet (USB)
CONFIG_USB_RTL8150=y
CONFIG_USB_RTL8152=y

# Wireless LAN - Atheros/Qualcomm
CONFIG_WLAN_VENDOR_ATH=y
CONFIG_ATH9K_HTC=y
CONFIG_CARL9170=y
CONFIG_ATH6KL=y
CONFIG_ATH6KL_USB=y

# Wireless LAN - MediaTek (mt76 series - compatible with kernel 6.1)
CONFIG_WLAN_VENDOR_MEDIATEK=y
CONFIG_MT76=m
CONFIG_MT76_USB=m
CONFIG_MT7601U=m

# Wireless LAN - Ralink (compatible with kernel 6.1)
CONFIG_WLAN_VENDOR_RALINK=y
CONFIG_RT2X00=y
CONFIG_RT2500USB=y
CONFIG_RT73USB=y
CONFIG_RT2800USB=y
CONFIG_RT2800USB_RT33XX=y
CONFIG_RT2800USB_RT35XX=y
CONFIG_RT2800USB_RT3573=y
CONFIG_RT2800USB_RT53XX=y
CONFIG_RT2800USB_RT55XX=y
CONFIG_RT2800USB_UNKNOWN=y

# Wireless LAN - Realtek (compatible with kernel 6.1)
CONFIG_WLAN_VENDOR_REALTEK=y
CONFIG_RTL8187=y
CONFIG_RTL_CARDS=y
CONFIG_RTL8192CU=y
CONFIG_RTL8XXXU_UNTESTED=y
# Note: RTL8812AU/8821AU/8814AU require kernel 6.14+ - not in kernel 6.1

# Wireless LAN - ZyDAS (compatible with kernel 6.1)
CONFIG_WLAN_VENDOR_ZYDAS=y
CONFIG_USB_ZD1201=y
CONFIG_ZD1211RW=y

# Wireless RNDIS USB
CONFIG_USB_NET_RNDIS_WLAN=y
```
